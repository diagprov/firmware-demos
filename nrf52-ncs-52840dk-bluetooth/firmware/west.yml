## nrf52-ncs-52840dk-bluetooth/firmware/west.yml
```yaml
manifest:
  self:
    path: firmware
  version: "0.10"
  remotes:
    - name: nordic
      url-base: https://github.com/nrfconnect
  projects:
    - name: sdk-nrf
      path: nrf
      remote: nordic
      revision: v1.9.0
      import: true
  
```

## nrf52-ncs-52840dk-bluetooth/west.yml
```yaml
manifest:
  remotes:
    - name: ncs
      url-base: https://github.com/nrfconnect
  defaults:
    remote: ncs
  projects:
    - name: nrf
      remote: ncs
      repo-path: sdk-nrf
      revision: v1.9.0
      import: true
  self:
    path: application
```
